## apps/examples/ieeedump/Kconfig
```kconfig
#
# For a description of the syntax of this configuration file,
# see misc/tools/kconfig-language.txt.
#

config EXAMPLES_IEEEDUMP
	bool "IEEE 802.15.4 packet dumper"
	default n
	---help---
		Enable the IEEE 802.15.4 packet dumper

if EXAMPLES_IEEEDUMP

config EXAMPLES_IEEEDUMP_PROGNAME
	string "Program name"
	default "ieeedump"
	depends on BUILD_KERNEL
	---help---
		This is the name of the program that will be use when the NSH ELF
		program is installed.

endif
```

## apps/ieee802154/sniffer/Kconfig
```kconfig
#
# For a description of the syntax of this configuration file,
# see misc/tools/kconfig-language.txt.
#

config IEEE802154_SNIFFER
	bool "IEEE 802.15.4 packet sniffer/dumper"
	default n
	---help---
		Enable the IEEE 802.15.4 packet sniffer/dumper

if IEEE802154_SNIFFER

config IEEE802154_SNIFFER_PROGNAME
	string "Program name"
	default "snif8"
	depends on BUILD_KERNEL
	---help---
		This is the name of the program that will be use when the NSH ELF
		program is installed.

endif
```

## nuttx/drivers/ieee802154/Kconfig
```kconfig
#
# For a description of the syntax of this configuration file,
# see misc/tools/kconfig-language.txt.
#

config MRF24J40
	bool "Microchip MRF24J40 IEEE 802.15.4 transceiver"
	default n
	depends on IEEE802154
	---help---
		This selection enables support for the Microchip MRF24J40 device.
```
